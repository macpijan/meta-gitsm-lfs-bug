## conf/layer.conf
```bitbake
# We have a conf and classes directory, add to BBPATH
BBPATH .= ":${LAYERDIR}"

# We have recipes-* directories, add to BBFILES
BBFILES += "${LAYERDIR}/recipes-*/*/*.bb \
            ${LAYERDIR}/recipes-*/*/*.bbappend"

BBFILE_COLLECTIONS += "meta-gitsm-bug"
BBFILE_PATTERN_meta-gitsm-bug = "^${LAYERDIR}/"
BBFILE_PRIORITY_meta-gitsm-bug = "6"

LAYERDEPENDS_meta-gitsm-bug = "core"
LAYERSERIES_COMPAT_meta-gitsm-bug = "gatesgarth master"
```
